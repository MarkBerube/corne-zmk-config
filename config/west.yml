## config/west.yml
```yaml
manifest:
  remotes:
    - name: zmkfirmware
      url-base: https://github.com/zmk
  projects:
    - name: zmkfirmware
      remote: zmkfirmware
      revision: main
      import: app/west.yml
  self:
    path: config
```
